/*@!Encoding:936*/
/*******************************************************************************
 * asu_wakeup: NVM测试专用 �?唤醒报文 + 阀控报�?周期发�?
 *
 * 完整流程:
 *   1. 持续�?0x505 NM 唤醒 (10ms 周期)
 *   2. 持续�?0x153 阀前提 ZCAirSuspCtrlSts=1 (100ms 周期)
 *   3. 持续�?0x66 阀控制 (100ms 周期):
 *      - Python 通过 SystemVariables("ASU", "ValveCmd").Value 改�?
 *      - CAPL �?@sysvar::ASU::ValveCmd 读取，实时生�?
 *
 * 报文信息:
 *   - 0x505 (1285) XCMZCUDCANFD3NmFr01: NM 唤醒
 *   - 0x153 (339)  ZcudZCUDCANFD3Fr02: 阀前提
 *   - 0x66  (102)  ZcudZCUDCANFD3Fr09: 阀控制
 *
 * 依赖:
 *   - �?CANoe System Variables 中手动创�?ASU::ValveCmd �?ASU::WakeupEnable
 ******************************************************************************/

includes
{
}

variables
{
  // ========== 报文定义 ==========
  message XCMZCUDCANFD3NmFr01 XcmNmMsg;   // 0x505 NM 唤醒
  message ZcudZCUDCANFD3Fr02 Fr02Msg;      // 0x153 阀前提
  message ZcudZCUDCANFD3Fr09 Fr09Msg;      // 0x66 阀控制

  // ========== 定时�?==========
  msTimer g_NmTimer;           // NM 周期 (10ms)
  msTimer g_AppTimer;          // 应用报文周期 (100ms)
}

on start
{
  write("========== asu_wakeup 已启�?==========");

  // 1. NM 唤醒报文内容: 00 50 80 22 50 00 00 00
  XcmNmMsg.byte(0) = 0x00;
  XcmNmMsg.byte(1) = 0x00;
  XcmNmMsg.byte(2) = 0x80;
  XcmNmMsg.byte(3) = 0x22;
  XcmNmMsg.byte(4) = 0x50;
  XcmNmMsg.byte(5) = 0x00;
  XcmNmMsg.byte(6) = 0x00;
  XcmNmMsg.byte(7) = 0x00;

  // 2. 阀控制前提
  Fr02Msg.ZCAirSuspCtrlStsZCAirSuspCtrlSts = 1;

  // 3. 阀控制: 初始值从 SysVar 读取
  Fr09Msg.SuspDistbnVlvCtrlStsSuspDistbnVlvCtrlSts = @sysvar::ASU::ValveCmd;

  // 4. 启动周期发�?
  setTimer(g_NmTimer, 10);     // 10ms 周期
  setTimer(g_AppTimer, 100);   // 100ms 周期

  write("[初始化] 唤醒周期 10ms, 阀控周�?100ms");
  write("[初始化] ValveCmd=%d, WakeupEnable=%d",
        @sysvar::ASU::ValveCmd, @sysvar::ASU::WakeupEnable);
}

/*******************************************************************************
 * on timer g_NmTimer: �?10ms 发一�?NM 唤醒 (循环)
 * 每次触发时读 SysVar WakeupEnable，实时响�?Python 修改
 *******************************************************************************/
on timer g_NmTimer
{
  if (@sysvar::ASU::WakeupEnable == 1)
  {
    output(XcmNmMsg);
  }
  setTimer(g_NmTimer, 10);
}

/*******************************************************************************
 * on timer g_AppTimer: �?100ms 发阀前提 + 阀控制 (循环)
 *
 * 关键：每次发之前�?System Variable（sysvar）的当前值�?
 * Python 通过 SystemVariables("ASU", "ValveCmd").Value 改的值，
 * CAPL �?@sysvar::ASU::ValveCmd 读到�?
 *******************************************************************************/
on timer g_AppTimer
{
  // �?sysvar �?Python 设的�?
  Fr09Msg.SuspDistbnVlvCtrlStsSuspDistbnVlvCtrlSts = @sysvar::ASU::ValveCmd;

  output(Fr02Msg);
  output(Fr09Msg);
  setTimer(g_AppTimer, 100);
}